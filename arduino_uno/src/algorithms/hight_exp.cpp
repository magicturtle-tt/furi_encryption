#include <Arduino.h>
#include <string.h>

#include "exp_common.h"

namespace {

const uint8_t DELTA[128] = {
    0x5A,0x6D,0x36,0x1B,0x0D,0x06,0x03,0x41,0x60,0x30,0x18,0x4C,0x66,0x33,0x59,0x2C,
    0x56,0x2B,0x15,0x4A,0x65,0x72,0x39,0x1C,0x4E,0x67,0x73,0x79,0x3C,0x5E,0x6F,0x37,
    0x5B,0x2D,0x16,0x0B,0x05,0x42,0x21,0x50,0x28,0x54,0x2A,0x55,0x6A,0x75,0x7A,0x7D,
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    0x64,0x32,0x19,0x0C,0x46,0x23,0x51,0x68,0x74,0x3A,0x5D,0x2E,0x57,0x6B,0x35,0x5A
};

const uint8_t HIGHT_F0[256] = {
    0x00,0x86,0x0D,0x8B,0x1A,0x9C,0x17,0x91,0x34,0xB2,0x39,0xBF,0x2E,0xA8,0x23,0xA5,
    0x68,0xEE,0x65,0xE3,0x72,0xF4,0x7F,0xF9,0x5C,0xDA,0x51,0xD7,0x46,0xC0,0x4B,0xCD,
    0xD0,0x56,0xDD,0x5B,0xCA,0x4C,0xC7,0x41,0xE4,0x62,0xE9,0x6F,0xFE,0x78,0xF3,0x75,
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    0x5A,0xDC,0x57,0xD1,0x40,0xC6,0x4D,0xCB,0x6E,0xE8,0x63,0xE5,0x74,0xF2,0x79,0xFF
};

const uint8_t HIGHT_F1[256] = {
    0x00,0x58,0xB0,0xE8,0x61,0x39,0xD1,0x89,0xC2,0x9A,0x72,0x2A,0xA3,0xFB,0x13,0x4B,
    0x85,0xDD,0x35,0x6D,0xE4,0xBC,0x54,0x0C,0x47,0x1F,0xF7,0xAF,0x26,0x7E,0x96,0xCE,
    0x0B,0x53,0xBB,0xE3,0x6A,0x32,0xDA,0x82,0xC9,0x91,0x79,0x21,0xA8,0xF0,0x18,0x40,
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    0xB4,0xEC,0x04,0x5C,0xD5,0x8D,0x65,0x3D,0x76,0x2E,0xC6,0x9E,0x17,0x4F,0xA7,0xFF
};

void hight_set_key(const uint8_t user_key[16], uint8_t rkey[136]) {
  for (uint8_t i = 0; i < 4; ++i) {
    rkey[i] = user_key[i + 12];
    rkey[i + 4] = user_key[i];
  }
  for (uint8_t i = 0; i < 8; ++i) {
    for (uint8_t j = 0; j < 8; ++j) {
      rkey[8 + 16 * i + j] = static_cast<uint8_t>(user_key[(j - i) & 7] + DELTA[16 * i + j]);
    }
    for (uint8_t j = 0; j < 8; ++j) {
      rkey[8 + 16 * i + j + 8] =
          static_cast<uint8_t>(user_key[((j - i) & 7) + 8] + DELTA[16 * i + j + 8]);
    }
  }
}

void hight_encrypt_block(const uint8_t rkey[136], const uint8_t in[8], uint8_t out[8]) {
  uint8_t x[8];
  x[1] = in[1]; x[3] = in[3]; x[5] = in[5]; x[7] = in[7];
  x[0] = static_cast<uint8_t>(in[0] + rkey[0]);
  x[2] = static_cast<uint8_t>(in[2] ^ rkey[1]);
  x[4] = static_cast<uint8_t>(in[4] + rkey[2]);
  x[6] = static_cast<uint8_t>(in[6] ^ rkey[3]);

#define HIGHT_ENC(k, i0,i1,i2,i3,i4,i5,i6,i7)                                    \
  do {                                                                             \
    x[i0] = static_cast<uint8_t>((x[i0] ^ (HIGHT_F0[x[i1]] + rkey[4 * (k) + 3])) & 0xFF); \
    x[i2] = static_cast<uint8_t>((x[i2] + (HIGHT_F1[x[i3]] ^ rkey[4 * (k) + 2])) & 0xFF); \
    x[i4] = static_cast<uint8_t>((x[i4] ^ (HIGHT_F0[x[i5]] + rkey[4 * (k) + 1])) & 0xFF); \
    x[i6] = static_cast<uint8_t>((x[i6] + (HIGHT_F1[x[i7]] ^ rkey[4 * (k) + 0])) & 0xFF); \
  } while (0)

  HIGHT_ENC( 2,  7,6,5,4,3,2,1,0); HIGHT_ENC( 3,  6,5,4,3,2,1,0,7);
  HIGHT_ENC( 4,  5,4,3,2,1,0,7,6); HIGHT_ENC( 5,  4,3,2,1,0,7,6,5);
  HIGHT_ENC( 6,  3,2,1,0,7,6,5,4); HIGHT_ENC( 7,  2,1,0,7,6,5,4,3);
  HIGHT_ENC( 8,  1,0,7,6,5,4,3,2); HIGHT_ENC( 9,  0,7,6,5,4,3,2,1);
  HIGHT_ENC(10,  7,6,5,4,3,2,1,0); HIGHT_ENC(11,  6,5,4,3,2,1,0,7);
  HIGHT_ENC(12,  5,4,3,2,1,0,7,6); HIGHT_ENC(13,  4,3,2,1,0,7,6,5);
  HIGHT_ENC(14,  3,2,1,0,7,6,5,4); HIGHT_ENC(15,  2,1,0,7,6,5,4,3);
  HIGHT_ENC(16,  1,0,7,6,5,4,3,2); HIGHT_ENC(17,  0,7,6,5,4,3,2,1);
  HIGHT_ENC(18,  7,6,5,4,3,2,1,0); HIGHT_ENC(19,  6,5,4,3,2,1,0,7);
  HIGHT_ENC(20,  5,4,3,2,1,0,7,6); HIGHT_ENC(21,  4,3,2,1,0,7,6,5);
  HIGHT_ENC(22,  3,2,1,0,7,6,5,4); HIGHT_ENC(23,  2,1,0,7,6,5,4,3);
  HIGHT_ENC(24,  1,0,7,6,5,4,3,2); HIGHT_ENC(25,  0,7,6,5,4,3,2,1);
  HIGHT_ENC(26,  7,6,5,4,3,2,1,0); HIGHT_ENC(27,  6,5,4,3,2,1,0,7);
  HIGHT_ENC(28,  5,4,3,2,1,0,7,6); HIGHT_ENC(29,  4,3,2,1,0,7,6,5);
  HIGHT_ENC(30,  3,2,1,0,7,6,5,4); HIGHT_ENC(31,  2,1,0,7,6,5,4,3);
  HIGHT_ENC(32,  1,0,7,6,5,4,3,2); HIGHT_ENC(33,  0,7,6,5,4,3,2,1);

  out[1] = x[2]; out[3] = x[4]; out[5] = x[6]; out[7] = x[0];
  out[0] = static_cast<uint8_t>(x[1] + rkey[4]);
  out[2] = static_cast<uint8_t>(x[3] ^ rkey[5]);
  out[4] = static_cast<uint8_t>(x[5] + rkey[6]);
  out[6] = static_cast<uint8_t>(x[7] ^ rkey[7]);

#undef HIGHT_ENC
}

void hight_decrypt_block(const uint8_t rkey[136], const uint8_t in[8], uint8_t out[8]) {
  uint8_t x[8];
  x[2] = in[1]; x[4] = in[3]; x[6] = in[5]; x[0] = in[7];
  x[1] = static_cast<uint8_t>(in[0] - rkey[4]);
  x[3] = static_cast<uint8_t>(in[2] ^ rkey[5]);
  x[5] = static_cast<uint8_t>(in[4] - rkey[6]);
  x[7] = static_cast<uint8_t>(in[6] ^ rkey[7]);

#define HIGHT_DEC(k, i0,i1,i2,i3,i4,i5,i6,i7)                                    \
  do {                                                                             \
    x[i1] = static_cast<uint8_t>((x[i1] - (HIGHT_F1[x[i2]] ^ rkey[4 * (k) + 2])) & 0xFF); \
    x[i3] = static_cast<uint8_t>((x[i3] ^ (HIGHT_F0[x[i4]] + rkey[4 * (k) + 1])) & 0xFF); \
    x[i5] = static_cast<uint8_t>((x[i5] - (HIGHT_F1[x[i6]] ^ rkey[4 * (k) + 0])) & 0xFF); \
    x[i7] = static_cast<uint8_t>((x[i7] ^ (HIGHT_F0[x[i0]] + rkey[4 * (k) + 3])) & 0xFF); \
  } while (0)

  HIGHT_DEC(33,  7,6,5,4,3,2,1,0); HIGHT_DEC(32,  0,7,6,5,4,3,2,1);
  HIGHT_DEC(31,  1,0,7,6,5,4,3,2); HIGHT_DEC(30,  2,1,0,7,6,5,4,3);
  HIGHT_DEC(29,  3,2,1,0,7,6,5,4); HIGHT_DEC(28,  4,3,2,1,0,7,6,5);
  HIGHT_DEC(27,  5,4,3,2,1,0,7,6); HIGHT_DEC(26,  6,5,4,3,2,1,0,7);
  HIGHT_DEC(25,  7,6,5,4,3,2,1,0); HIGHT_DEC(24,  0,7,6,5,4,3,2,1);
  HIGHT_DEC(23,  1,0,7,6,5,4,3,2); HIGHT_DEC(22,  2,1,0,7,6,5,4,3);
  HIGHT_DEC(21,  3,2,1,0,7,6,5,4); HIGHT_DEC(20,  4,3,2,1,0,7,6,5);
  HIGHT_DEC(19,  5,4,3,2,1,0,7,6); HIGHT_DEC(18,  6,5,4,3,2,1,0,7);
  HIGHT_DEC(17,  7,6,5,4,3,2,1,0); HIGHT_DEC(16,  0,7,6,5,4,3,2,1);
  HIGHT_DEC(15,  1,0,7,6,5,4,3,2); HIGHT_DEC(14,  2,1,0,7,6,5,4,3);
  HIGHT_DEC(13,  3,2,1,0,7,6,5,4); HIGHT_DEC(12,  4,3,2,1,0,7,6,5);
  HIGHT_DEC(11,  5,4,3,2,1,0,7,6); HIGHT_DEC(10,  6,5,4,3,2,1,0,7);
  HIGHT_DEC( 9,  7,6,5,4,3,2,1,0); HIGHT_DEC( 8,  0,7,6,5,4,3,2,1);
  HIGHT_DEC( 7,  1,0,7,6,5,4,3,2); HIGHT_DEC( 6,  2,1,0,7,6,5,4,3);
  HIGHT_DEC( 5,  3,2,1,0,7,6,5,4); HIGHT_DEC( 4,  4,3,2,1,0,7,6,5);
  HIGHT_DEC( 3,  5,4,3,2,1,0,7,6); HIGHT_DEC( 2,  6,5,4,3,2,1,0,7);

  out[1] = x[1]; out[3] = x[3]; out[5] = x[5]; out[7] = x[7];
  out[0] = static_cast<uint8_t>(x[0] - rkey[0]);
  out[2] = static_cast<uint8_t>(x[2] ^ rkey[1]);
  out[4] = static_cast<uint8_t>(x[4] - rkey[2]);
  out[6] = static_cast<uint8_t>(x[6] ^ rkey[3]);

#undef HIGHT_DEC
}

bool hight_self_test() {
  const uint8_t tv_key[16] = {
      0x88,0xE3,0x4F,0x8F,0x08,0x17,0x79,0xF1,0xE9,0xF3,0x94,0x37,0x0A,0xD4,0x05,0x89};
  const uint8_t tv_pt[8] = {0xD7,0x6D,0x0D,0x18,0x32,0x7E,0xC5,0x62};
  const uint8_t tv_ct[8] = {0xE4,0xBC,0x2E,0x31,0x22,0x77,0xE4,0xDD};
  uint8_t rkey[136];
  uint8_t buf[8];
  hight_set_key(tv_key, rkey);
  hight_encrypt_block(rkey, tv_pt, buf);
  if (memcmp(buf, tv_ct, sizeof(buf)) != 0) {
    return false;
  }
  hight_decrypt_block(rkey, buf, buf);
  return memcmp(buf, tv_pt, sizeof(buf)) == 0;
}

}  // namespace

void run_hight_experiments(void) {
  const uint8_t key[16] = {
      0x00, 0x01, 0x02, 0x03,
      0x04, 0x05, 0x06, 0x07,
      0x08, 0x09, 0x0A, 0x0B,
      0x0C, 0x0D, 0x0E, 0x0F};
  const uint8_t in_block[8] = {
      0x10, 0x11, 0x12, 0x13,
      0x14, 0x15, 0x16, 0x17};

  if (!hight_self_test()) {
    print_unsupported_algo(F("hight"), 16, 8, key[0], in_block[0],
                           F("self-test failed"));
    return;
  }

  uint8_t rkey[136];
  uint8_t out_block[8] = {0};
  hight_set_key(key, rkey);

  unsigned long time_trials = 0UL;
  for (int i = 0; i < 200; ++i) {
    const unsigned long start = micros();
    hight_encrypt_block(rkey, in_block, out_block);
    hight_decrypt_block(rkey, out_block, out_block);
    time_trials += (micros() - start);
  }

  print_experiment_row(F("hight_ref"), 16, 8, time_trials / 200UL, key[0], out_block[0],
                       F("HIGHT standalone"));
}
